## boards/shields/ergo_s1/Kconfig.shield
```kconfig
# Copyright (c) 2021 The ZMK Contributors
# SPDX-License-Identifier: MIT
config SHIELD_ERGO_S1_LEFT
    def_bool $(shields_list_contains,ergo_s1_left)

config SHIELD_ERGO_S1_RIGHT
    def_bool $(shields_list_contains,ergo_s1_right)
```
